## conf/layer.conf
```bitbake
# We have a conf and classes directory, add to BBPATH
BBPATH .= ":${LAYERDIR}"

# We have recipes-* directories, add to BBFILES
BBFILES += "${LAYERDIR}/recipes-*/*/*.bb \
            ${LAYERDIR}/recipes-*/*/*.bbappend \
            ${LAYERDIR}/images/*.bb"

BBFILE_COLLECTIONS += "meta-opencardev"
BBFILE_PATTERN_meta-opencardev = "^${LAYERDIR}/"
BBFILE_PRIORITY_meta-opencardev = "10"

LAYERDEPENDS_meta-opencardev = "core openembedded-layer qt5-layer"
LAYERSERIES_COMPAT_meta-opencardev = "dunfell"
```

## meta-crankshaft/conf/layer.conf
```bitbake
# We have a conf and classes directory, add to BBPATH
BBPATH .= ":${LAYERDIR}"

# We have recipes-* directories, add to BBFILES
BBFILES += "${LAYERDIR}/recipes-*/*/*.bb \
            ${LAYERDIR}/recipes-*/*/*.bbappend \
            ${LAYERDIR}/images/*.bb"

BBFILE_COLLECTIONS += "meta-crankshaft"
BBFILE_PATTERN_meta-crankshaft = "^${LAYERDIR}/"
BBFILE_PRIORITY_meta-crankshaft = "10"

LAYERDEPENDS_meta-crankshaft = "core openembedded-layer qt5-layer meta-openauto"
LAYERSERIES_COMPAT_meta-crankshaft = "warrior zeus dunfell gatesgarth hardknott"
```

## meta-crankshaft/conf/local.conf
```bitbake
LICENSE_FLAGS_WHITELIST_append = " commercial_faad2"
VIRTUAL-RUNTIME_init_manager = "systemd"
DISTRO_FEATURES_append = " systemd"
DISTRO_FEATURES_BACKFILL_CONSIDERED = "sysvinit"
# add QT5
IMAGE_INSTALL_append = " make cmake"
IMAGE_INSTALL_append = " qtbase-tools qtbase qtdeclarative qtimageformats qtmultimedia qtquickcontrols2 qtquickcontrols qtbase-plugins cinematicexperience liberation-fonts"
PACKAGECONFIG_FONTS_append_pn-qtbase = " fontconfig"
# enable remote qt dev
IMAGE_INSTALL_append = " openssh-sftp-server rsync"

# add bluetooth
MACHINE_FEATURES += " bluetooth"
CORE_IMAGE_EXTRA_INSTALL = " rsync "
DISTRO_FEATURES_append = " pi-bluetooth bluez5 bluetooth linux-firmware-bcm43430 linux-firmware-brcmfmac43430"
IMAGE_INSTALL_append = " pi-bluetooth bluez5 bluez5-testtools linux-firmware-bcm43430 i2c-tools hostapd dhcp-server udev-rules-rpi bridge-utils iptables linux-firmware-ralink linux-firmware-rtl8192ce linux-firmware-rtl8192cu linux-firmware-rtl8192su linux-firmware-rpidistro-bcm43430"
ENABLE_UART = "1"

# add audio
IMAGE_INSTALL_append = " gstreamer1.0-plugins-good gstreamer1.0-plugins-base gstreamer1.0-plugins-ugly"
LICENSE_FLAGS_WHITELIST_append = " commercial  commercial_gstreamer1.0-plugins-ugly commercial_gstreamer1.0-plugins-ugly"
PACKAGECONFIG_append_pn-qtmultimedia = " gstreamer alsa" 

# add pulse audio required to stream over bluetooth
DISTRO_FEATURES_append = " pulseaudio"
IMAGE_INSTALL_append = " pulseaudio pulseaudio-module-dbus-protocol pulseaudio-server pulseaudio-module-bluetooth-discover pulseaudio-module-bluetooth-policy pulseaudio-module-bluez5-device pulseaudio-module-bluez5-discover alsa-utils alsa-plugins"
```

## meta-crankshaft/conf/local.conf.sample
```bitbake
# Local configuration for meta-rpi images
# Yocto Project 3.1 Poky distribution [dunfell] branch
# This is a sysvinit system

# mask wireguard from meta-openembedded/meta-networking
# use version in meta-jumpnow to support kernels < 5.6
# with wireguard-linux-compat
BBMASK = "meta-networking/recipes-kernel/wireguard"

LICENSE_FLAGS_WHITELIST = "commercial"

DISTRO_FEATURES_append = " pulseaudio bluetooth bluez5 ext2 usbhost ${DISTRO_FEATURES_LIBC} systemd "


PREFERRED_PROVIDER_jpeg = "libjpeg-turbo"
PREFERRED_PROVIDER_jpeg-native = "libjpeg-turbo-native"

PREFERRED_PROVIDER_udev = "eudev"

VIRTUAL-RUNTIME_init_manager = "systemd"
VIRTUAL-RUNTIME_initscripts = ""

MACHINE_FEATURES_remove = "apm"

IMAGE_FSTYPES = "rpi-sdimg"

MACHINE = "raspberrypi4-64"

KERNEL_IMAGETYPE = "Image"

# uncomment for kernels < 5.6
WIREGUARD_COMPAT = "1"

DISABLE_OVERSCAN = "1"
# ENABLE_UART = "1"
SERIAL_CONSOLES = ""

# default to 5.10
PREFERRED_VERSION_linux-raspberrypi = "5.10.%"
# PREFERRED_VERSION_linux-raspberrypi = "4.19.%"

# DL_DIR = "/src/oe"
# SSTATE_DIR = "/oe8/rpi64/sstate-cache"
# TMPDIR = "/oe8/rpi64/tmp-zeus"

DISTRO = "poky"
PACKAGE_CLASSES = "package_ipk"

# i686 or x86_64
SDKMACHINE = "x86_64"

# for no root passwd uncomment the following and comment the two extra user lines
# EXTRA_IMAGE_FEATURES = "debug-tweaks"

# for a root passwd, change jumpnowtek below to your password
INHERIT += "extrausers"
EXTRA_USERS_PARAMS = "\
	usermod -P raspberry root; \
	useradd -P raspberry -G sudo pi; \
	groupadd netdev; \
"

# this will force root to change password on first login
# INHERIT += "chageusers"
# CHAGE_USERS_PARAMS = "chage -d0 root; "

USER_CLASSES = "image-mklibs image-prelink"
PATCHRESOLVE = "noop"
RM_OLD_IMAGE = "1"
# INHERIT += "rm_work"
CONF_VERSION = "1"

LICENSE_FLAGS_WHITELIST_append = " commercial_faad2"
VIRTUAL-RUNTIME_init_manager = "systemd"
DISTRO_FEATURES_append = " systemd"
DISTRO_FEATURES_BACKFILL_CONSIDERED = "sysvinit"
# add QT5
IMAGE_INSTALL_append = " make cmake"
IMAGE_INSTALL_append = " qtbase-tools qtbase qtdeclarative qtimageformats qtmultimedia qtquickcontrols2 qtquickcontrols qtbase-plugins cinematicexperience liberation-fonts"
PACKAGECONFIG_FONTS_append_pn-qtbase = " fontconfig"
# enable remote qt dev
IMAGE_INSTALL_append = " openssh-sftp-server rsync"

# add bluetooth
MACHINE_FEATURES += " bluetooth"
CORE_IMAGE_EXTRA_INSTALL = " rsync "
DISTRO_FEATURES_append = " pi-bluetooth bluez5 bluetooth linux-firmware-bcm43430 linux-firmware-brcmfmac43430"
IMAGE_INSTALL_append = " pi-bluetooth bluez5 bluez5-testtools linux-firmware-bcm43430 i2c-tools hostapd dhcp-server udev-rules-rpi bridge-utils iptables linux-firmware-ralink linux-firmware-rtl8192ce linux-firmware-rtl8192cu linux-firmware-rtl8192su linux-firmware-rpidistro-bcm43430"
ENABLE_UART = "1"

# add audio
IMAGE_INSTALL_append = " gstreamer1.0-plugins-good gstreamer1.0-plugins-base gstreamer1.0-plugins-ugly"
LICENSE_FLAGS_WHITELIST_append = " commercial  commercial_gstreamer1.0-plugins-ugly commercial_gstreamer1.0-plugins-ugly"
PACKAGECONFIG_append_pn-qtmultimedia = " gstreamer alsa" 

# add pulse audio required to stream over bluetooth
DISTRO_FEATURES_append = " pulseaudio"
IMAGE_INSTALL_append = " pulseaudio pulseaudio-module-dbus-protocol pulseaudio-server pulseaudio-module-bluetooth-discover pulseaudio-module-bluetooth-policy pulseaudio-module-bluez5-device pulseaudio-module-bluez5-discover alsa-utils alsa-plugins"
```

## meta-crankshafthost/conf/bblayers.conf.sample
```bitbake
# POKY_BBLAYERS_CONF_VERSION is increased each time build/conf/bblayers.conf
# changes incompatibly
POKY_BBLAYERS_CONF_VERSION = "2"

BBPATH = "${TOPDIR}"
BBFILES ?= ""

BBLAYERS ?= " \
  ${HOME}/yocto/poky-hardknott/meta \
  ${HOME}/yocto/poky-hardknott/meta-poky \
  ${HOME}/yocto/poky-hardknott/meta-openembedded/meta-oe \
  ${HOME}/yocto/poky-hardknott/meta-openembedded/meta-multimedia \
  ${HOME}/yocto/poky-hardknott/meta-openembedded/meta-networking \
  ${HOME}/yocto/poky-hardknott/meta-openembedded/meta-perl \
  ${HOME}/yocto/poky-hardknott/meta-openembedded/meta-python \
  ${HOME}/yocto/poky-hardknott/meta-openembedded/meta-filesystems \
  ${HOME}/yocto/poky-hardknott/meta-openembedded/meta-gnome \
  ${HOME}/yocto/poky-hardknott/meta-virtualization \
  ${HOME}/yocto/poky-hardknott/meta-qt5 \
  ${HOME}/yocto/poky-hardknott/meta-raspberrypi \
  ${HOME}/yocto/poky-hardknott/meta-security \
  ${HOME}/yocto/poky-hardknott/meta-opencardev/meta-openauto \
  ${HOME}/yocto/poky-hardknott/meta-opencardev/meta-crankshaft \
"
```

## meta-crankshafthost/conf/layer.conf
```bitbake
# We have a conf and classes directory, add to BBPATH
BBPATH .= ":${LAYERDIR}"

# We have recipes-* directories, add to BBFILES
BBFILES += "${LAYERDIR}/recipes-*/*/*.bb \
            ${LAYERDIR}/recipes-*/*/*.bbappend \
            ${LAYERDIR}/images/*.bb"

BBFILE_COLLECTIONS += "meta-crankshafthost"
BBFILE_PATTERN_meta-crankshafthost = "^${LAYERDIR}/"
BBFILE_PRIORITY_meta-crankshafthost = "11"

LAYERDEPENDS_meta-crankshafthost = "core openembedded-layer meta-python multimedia-layer networking-layer perl-layer filesystems-layer virtualization-layer security "
LAYERSERIES_COMPAT_meta-crankshafthost = "kirkstone"
```

## meta-openauto/conf/layer.conf
```bitbake
# We have a conf and classes directory, add to BBPATH
BBPATH .= ":${LAYERDIR}"

# We have recipes-* directories, add to BBFILES
BBFILES += "${LAYERDIR}/recipes-*/*/*.bb \
            ${LAYERDIR}/recipes-*/*/*.bbappend \
            ${LAYERDIR}/images/*.bb"

BBFILE_COLLECTIONS += "meta-openauto"
BBFILE_PATTERN_meta-openauto = "^${LAYERDIR}/"
BBFILE_PRIORITY_meta-openauto = "10"

LAYERDEPENDS_meta-openauto = "core openembedded-layer"
LAYERSERIES_COMPAT_meta-openauto = "warrior zeus dunfell gatesgarth hardknott"
```
